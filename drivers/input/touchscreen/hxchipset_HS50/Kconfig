## drivers/input/touchscreen/hxchipset_HS50/Kconfig
```kconfig
#
# Himax Touchscreen driver configuration
#

config TOUCHSCREEN_HIMAX_I2C
        tristate "HIMAX HS50 chipset I2C touchscreen"
        depends on TOUCHSCREEN_HIMAX_CHIPSET
        help
          This enables support for the HIMAX HS50 chipset over I2C-based touchscreens.

config TOUCHSCREEN_HIMAX_DEBUG
        bool "HIMAX HS50 debug function"
        depends on TOUCHSCREEN_HIMAX_I2C
        help
          This enables support for the HIMAX HS50 debug function.

config TOUCHSCREEN_HIMAX_ITO_TEST
        tristate "HIMAX HS50 driver test over Dragon Board"
        depends on TOUCHSCREEN_HIMAX_I2C
        help
          This enables support for the HIMAX HS50 driver test over Dragon Board.

config HMX_DB
        bool "HIMAX HS50 driver test over Dragon Board"
        depends on TOUCHSCREEN_HIMAX_I2C
        help
          This enables support for the HIMAX HS50 driver test over Dragon Board.



# ***************** In-cell Start *****************
config TOUCHSCREEN_HIMAX_IC_HX83192
        tristate "HIMAX chipset HX83192 function"
		depends on TOUCHSCREEN_HIMAX_INCELL
		help
		This enables support for HIMAX CHIPSET of HX83192.

config TOUCHSCREEN_HIMAX_IC_HX83191
        tristate "HIMAX chipset HX83191 function"
		depends on TOUCHSCREEN_HIMAX_INCELL
		help
		This enables support for HIMAX CHIPSET of HX83191.

config TOUCHSCREEN_HIMAX_IC_HX83113
        tristate "HIMAX chipset HX83113 function"
		depends on TOUCHSCREEN_HIMAX_INCELL
		help
		This enables support for HIMAX CHIPSET of HX83113.

config TOUCHSCREEN_HIMAX_IC_HX83112
        tristate "HIMAX chipset HX83112 function"
		depends on TOUCHSCREEN_HIMAX_INCELL
		help
		This enables support for HIMAX CHIPSET of HX83112.

config TOUCHSCREEN_HIMAX_IC_HX83111
        tristate "HIMAX chipset HX83111 function"
		depends on TOUCHSCREEN_HIMAX_INCELL
		help
		This enables support for HIMAX CHIPSET of HX83111.

config TOUCHSCREEN_HIMAX_IC_HX83106
        tristate "HIMAX chipset HX83106 function"
		depends on TOUCHSCREEN_HIMAX_INCELL
		help
		This enables support for HIMAX CHIPSET of HX83106.

config TOUCHSCREEN_HIMAX_IC_HX83103
        tristate "HIMAX chipset HX83103 function"
		depends on TOUCHSCREEN_HIMAX_INCELL
		help
		This enables support for HIMAX CHIPSET of HX83103.

config TOUCHSCREEN_HIMAX_IC_HX83102
        tristate "HIMAX chipset HX83102 function"
		depends on TOUCHSCREEN_HIMAX_INCELL
		help
		This enables support for HIMAX CHIPSET of HX83102.

# ***************** In-cell End *******************

config TOUCHSCREEN_HIMAX_DEBUG
        bool "HIMAX debug function"
		depends on TOUCHSCREEN_HIMAX_INCELL || TOUCHSCREEN_HIMAX_ONCELL
		help
		This enables support for HIMAX debug function.
config TOUCHSCREEN_HIMAX_INSPECT
        bool "HIMAX inspect function"
		depends on TOUCHSCREEN_HIMAX_INCELL || TOUCHSCREEN_HIMAX_ONCELL
		help
		This enables support for HIMAX debug function.

config TOUCHSCREEN_HIMAX_EMBEDDED_FIRMWARE
	bool "HIMAX embedded firmware function"
		depends on TOUCHSCREEN_HIMAX_INCELL || TOUCHSCREEN_HIMAX_ONCELL
		help
		This enables built-in FW inside kernel as binary array

config HMX_DB
	bool "HIMAX driver test over Dragon Board"
	depends on TOUCHSCREEN_HIMAX_COMMON
	help
	  This enables support for HIMAX driver test over Dragon Board.
```
